## conf/layer.conf
```bitbake
# We have a conf and classes directory, add to BBPATH
BBPATH := "${BBPATH}:${LAYERDIR}"

# We have a recipes directory, add to BBFILES
BBFILES := "${BBFILES} ${LAYERDIR}/recipes-*/*/*.bb \
	${LAYERDIR}/recipes-*/*/*.bbappend"

# Please replace thinkdemo in the three lines below with 
# the chosen name for the application 
BBFILE_COLLECTIONS += "thinkdemo"
BBFILE_PATTERN_thinkdemo := "^${LAYERDIR}/"
BBFILE_PRIORITY_thinkdemo = "7"
```
